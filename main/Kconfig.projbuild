## main/Kconfig.projbuild
```kconfig
menu "Example Configuration"

    config LILYGO_LILY_PI
        bool "LilyGO Lily Pi board (3.5\" ST7796 display)"
        default n
        help
            Enable 480x320 SPI display, PSRAM, and backlight status on GPIO12.
            Set via sdkconfig.lilygo-lily-pi.defaults for PlatformIO env lilygo-lily-pi.

    config WAVESHARE_ESP32_S3_TOUCH_LCD_128
        bool "Waveshare ESP32-S3-Touch-LCD-1.28 (GC9A01 round display)"
        default n
        help
            Enable 240x240 SPI display (GC9A01), PSRAM, backlight on GPIO2.
            GPS UART2 on SH1.0 GPIO16/17. PlatformIO env waveshare-esp32-s3-touch-lcd-1.

    config EXAMPLE_DUMP_ADV_DATA_AND_SCAN_RESP
        bool "Dump whole adv data and scan response data in example"
        default n

    config EXAMPLE_CI_ID
        int
        default 70
        help
            This config the example id for CI test. Only for internal used.

    config EXAMPLE_CI_PIPELINE_ID
        int "The pipeline id for CI test"
        default 0
        help
            This config the pipeline id for CI test. Only for internal used.

endmenu
```
